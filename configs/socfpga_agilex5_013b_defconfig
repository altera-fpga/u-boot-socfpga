## configs/socfpga_agilex5_013b_defconfig
```kconfig
#include <configs/socfpga_agilex5_defconfig>

CONFIG_DEFAULT_DEVICE_TREE="socfpga_agilex5_socdk_013b"
CONFIG_TARGET_SOCFPGA_AGILEX5_013B=y
CONFIG_PHY_MARVELL=n
CONFIG_PHY_MICREL=y
CONFIG_PHY_MICREL_KSZ90X1=y
CONFIG_SYS_SPI_U_BOOT_OFFS=0x0a00000
```

## configs/socfpga_agilex5_a0_defconfig
```kconfig
#include <configs/socfpga_agilex5_defconfig>

CONFIG_DEFAULT_DEVICE_TREE="socfpga_agilex5_socdk_a0"
# CONFIG_SPL_MMC_UHS_SUPPORT is not set
# CONFIG_MMC_UHS_SUPPORT is not set
```

## configs/socfpga_agilex5_a0_emmc_defconfig
```kconfig
#include <configs/socfpga_agilex5_emmc_defconfig>

CONFIG_DEFAULT_DEVICE_TREE="socfpga_agilex5_socdk_a0_emmc"
# CONFIG_MMC_HS200_SUPPORT is not set
# CONFIG_SPL_MMC_HS200_SUPPORT is not set
# CONFIG_MMC_HS400_SUPPORT is not set
# CONFIG_SPL_MMC_HS400_SUPPORT is not set
```

## configs/socfpga_agilex5_a0_modular_defconfig
```kconfig
#include <configs/socfpga_agilex5_modular_defconfig>

CONFIG_DEFAULT_DEVICE_TREE="socfpga_agilex5_socdk_a0_modular"
# CONFIG_SPL_MMC_UHS_SUPPORT is not set
# CONFIG_MMC_UHS_SUPPORT is not set
```

## configs/socfpga_agilex72_emmc_defconfig
```kconfig
#include <configs/socfpga_agilex72_defconfig>

CONFIG_DEFAULT_DEVICE_TREE="socfpga_agilex72_socdk_emmc"
# CONFIG_SPL_DM_REGULATOR_GPIO is not set
# CONFIG_DM_REGULATOR_GPIO is not set
# CONFIG_SPL_DWAPB_GPIO is not set
# CONFIG_SPL_MMC_UHS_SUPPORT is not set
# CONFIG_MMC_UHS_SUPPORT is not set
# CONFIG_MMC_HS200_SUPPORT is not set
# CONFIG_SPL_MMC_HS200_SUPPORT is not set
# CONFIG_MMC_HS400_SUPPORT is not set
# CONFIG_SPL_MMC_HS400_SUPPORT is not set
```

## configs/socfpga_agilex_emmc_defconfig
```kconfig
#include <configs/socfpga_agilex_defconfig>

CONFIG_DEFAULT_DEVICE_TREE="intel/socfpga_agilex_socdk_emmc"
CONFIG_OF_LIST="intel/socfpga_agilex_socdk_emmc"
```

## test/socfpga/Kconfig
```kconfig
config UT_SOCFPGA
	bool "Enable SoC FPGA sandbox unit tests"
	depends on SANDBOX
	default y
	help
	  This enables the 'ut socfpga' command, which runs sandbox unit
	  tests covering Altera SoC FPGA drivers. RSU is the first driver
	  to ship under this suite (test/socfpga/rsu.c); FPGA manager, SDM
	  mailbox, sysmgr and similar drivers are expected to add their
	  own test/socfpga/<driver>.c files as they get sandbox-ported,
	  with no further sandbox-harness plumbing required.
```
