// SPDX-License-Identifier: GPL-2.0+
/*
 * U-Boot additions Agilex5 SocDK A0
 *
 * Copyright (C) 2026 Altera Corporation <www.altera.com>
 */

#include "socfpga_agilex5_socdk-u-boot.dtsi"

#if !defined(CONFIG_SOCFPGA_SECURE_VAB_AUTH)
&fdt_0_blob {
	filename = "arch/arm/dts/socfpga_agilex5_socdk_a0.dtb";
};
#endif
